## dts/bindings/wifi/infineon,airoc-wifi-spi.yaml
```yaml
description: |
  AIROC Wi-Fi Connectivity over SPI.

compatible: "infineon,airoc-wifi"

include: [spi-device.yaml, "infineon,airoc-wifi-common.yaml"]

properties: 
  wifi-host-wake-gpios:
    required: true
    description: |
      Host wake-up gpio. Signal from the AIROC Wi-Fi device
      to the host indicating that the device requires attention.
    type: phandle-array
```

## samples/net/wifi/boards/rpi_pico_w.conf
```kconfig
# TODO many of these should get moved to board option.
CONFIG_WIFI_AIROC=y
CONFIG_CYW43439=y
CONFIG_AIROC_WIFI_BUS_SPI=y
CONFIG_HEAP_MEM_POOL_SIZE=32000
# whd_wifi_read_fw_capabilities needs MAX_CAP_BUFFER_SIZE of stack
CONFIG_MAIN_STACK_SIZE=4096
###### TODO unset these
CONFIG_ASSERT=y
CONFIG_DEBUG_THREAD_INFO=y
CONFIG_WIFI_LOG_LEVEL_INF=y
# WHD_COUNTRY_UNITED_STATES
CONFIG_AIROC_WIFI_COUNTRY=21333
CONFIG_STACK_CANARIES=y
```
